## conf/machine/kitra710C.conf
```bitbake
#@TYPE: Machine
#@NAME: RushUp Kitra710C
#@SOC:ARM Cortex-A53
#@DESCRIPTION: Machine configuration for RushUp Kitra710C

MACHINEOVERRIDES = "artik710:${MACHINE}"
include conf/machine/artik710.conf

KERNEL_DEVICETREE = " \
    nexell/s5p6818-artik710-raptor-rev00.dtb \
    nexell/s5p6818-artik710-raptor-rev01.dtb \
    nexell/s5p6818-artik710-raptor-rev03.dtb \
    nexell/s5p6818-kitra710C.dtb \
    "

PREFERRED_PROVIDER_virtual/kernel = "linux-yocto-rushup-710"

KBUILD_DEFCONFIG = "kitra710C_defconfig"
```

## conf/machine/kitragti.conf
```bitbake
#@TYPE: Machine
#@NAME: RushUp KitraGTI
#@SOC:ARM Cortex-A53
#@DESCRIPTION: Machine configuration for RushUp KitraGTI

MACHINEOVERRIDES = "artik710:${MACHINE}"
include conf/machine/artik710.conf

KERNEL_DEVICETREE = " \
    nexell/s5p6818-artik710-raptor-rev00.dtb \
    nexell/s5p6818-artik710-raptor-rev01.dtb \
    nexell/s5p6818-artik710-raptor-rev03.dtb \
    nexell/s5p6818-kitragti.dtb \
    "

PREFERRED_PROVIDER_virtual/kernel = "linux-yocto-rushup-710"

KBUILD_DEFCONFIG = "kitragti_defconfig"
```
